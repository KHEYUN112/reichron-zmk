## boards/shields/reichron/Kconfig.defconfig
```kconfig
if SHIELD_REICHRON

config ZMK_KEYBOARD_NAME
    default "reichron"

endif

if ZMK_DISPLAY

config I2C
    default y

config SSD1306
    default y

endif # ZMK_DISPLAY
```

## config/west.yml
```yaml
manifest:
  remotes:
    - name: zmkfirmware
      url-base: https://github.com/zmkfirmware
  projects:
    - name: zmk
      remote: zmkfirmware
      revision: 66aee4cd7764ad7b4b85a7a7b88b3b2b78eed3e0
      import: app/west.yml
  self:
    path: config
```
